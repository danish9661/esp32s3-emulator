const uint8_t C[1584] = {
0xb1,
0x70,
0x25,
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0x5b,
0xab
};

const uint8_t IV[16] = {
0x00,
0x01,
0x02,
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0x0e,
0x0f
};

const uint8_t X[512] = {
0x15,
0xcd,
0x5b,
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0x00,
0x00
};

const uint8_t ZEXP[512] = {
0xb3,
0x29,
0x9c,
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0x00,
0x00
};

// ESP32-S3 Digital Signature (DS) peripheral validation via direct register
// pokes. The encrypted RSA key blob `C` (Y||M||Rb||md||mprime||length||0x08*8,
// AES-256-CBC with aes_key = HMAC-SHA256(efuse_key=0, 0xFF*32)), the IV, the
// message X, and the expected signature ZEXP were all generated on the host
// from a real RSA-1024 key. eFuse key block 0 is all-zero in the emulator, so
// the model reproduces the same aes_key. The sketch feeds the blob to the DS
// peripheral and checks the produced signature equals ZEXP.

#define DS_BASE 0x6003D000UL

static inline void wr(uint32_t a, uint32_t v) { *(volatile uint32_t*)a = v; }
static inline uint32_t rd(uint32_t a) { return *(volatile uint32_t*)a; }

void write_bytes(uint32_t base, const uint8_t* data, int len) {
  for (int i = 0; i < len; i += 4) {
    uint32_t w = (uint32_t)data[i] | ((uint32_t)data[i+1] << 8) |
                 ((uint32_t)data[i+2] << 16) | ((uint32_t)data[i+3] << 24);
    wr(base + i, w);
  }
}

void setup() {
  Serial.begin(115200);
  delay(200);
  Serial.println("DS VALIDATION START");
  // C is contiguous: C_Y(0x000) || C_M(0x200) || C_RB(0x400) || C_BOX(0x600).
  write_bytes(DS_BASE + 0x000, C, sizeof(C));
  write_bytes(DS_BASE + 0x630, IV, sizeof(IV));
  write_bytes(DS_BASE + 0x800, X, sizeof(X));
  wr(DS_BASE + 0xE00, 1);  // SET_START -> decrypt + sign
  uint32_t check = rd(DS_BASE + 0xE14);  // QUERY_CHECK
  uint8_t z[512];
  for (int i = 0; i < 512; i += 4) {
    uint32_t w = rd(DS_BASE + 0xA00 + i);
    z[i] = w & 0xff; z[i+1] = (w >> 8) & 0xff;
    z[i+2] = (w >> 16) & 0xff; z[i+3] = (w >> 24) & 0xff;
  }
  Serial.print("DS QUERY_CHECK=");
  Serial.println(check);
  bool ok = (check == 0);
  for (int i = 0; i < 512; i++) if (z[i] != ZEXP[i]) ok = false;
  Serial.print("DS Z=");
  for (int i = 0; i < 32; i++) {
    if (z[i] < 0x10) Serial.print("0");
    Serial.print(z[i], HEX);
  }
  Serial.println(ok ? " OK" : " MISMATCH");
  Serial.println("DS DONE");
}

void loop() { delay(1000); }
