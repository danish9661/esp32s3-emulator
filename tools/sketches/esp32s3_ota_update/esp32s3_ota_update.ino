// OTA end-to-end update test: writes the embedded slot-1 image (built
// from esp32s3_ota_slot1, see tools/build_ota.sh) into the ota_1 partition
// through the real esp_ota_* driver path (erase + page program + otadata),
// then reboots. The emulator must come back up running the slot-1 image
// ("OTA SLOT1 ALIVE").
#include <Arduino.h>
#include "esp_ota_ops.h"
#include "esp_partition.h"
#include "esp_system.h"
#include "ota_slot1_image.h"  // generated by tools/build_ota.sh (gitignored)

void setup() {
  Serial.begin(115200);
  delay(200);
  const esp_partition_t *running = esp_ota_get_running_partition();
  Serial.printf("OTA RUNNING %s\n", running ? running->label : "(null)");
  if (running && (strcmp(running->label, "app1") == 0)) {
    Serial.println("OTA ALREADY SLOT1");
    return;
  }
  const esp_partition_t *target =
      esp_partition_find_first(ESP_PARTITION_TYPE_APP, ESP_PARTITION_SUBTYPE_APP_OTA_1, NULL);
  if (!target) {
    Serial.println("OTA NO TARGET");
    return;
  }
  Serial.printf("OTA TARGET %s type %u subtype %u addr %lx size %u img %u\n", target->label,
                (unsigned)target->type, (unsigned)target->subtype,
                (unsigned long)target->address,
                (unsigned)target->size, (unsigned)ota_slot1_bin_len);
  Serial.printf("OTA COUNT %u\n", (unsigned)esp_ota_get_app_partition_count());
  esp_ota_handle_t h;
  esp_err_t err = esp_ota_begin(target, OTA_SIZE_UNKNOWN, &h);
  Serial.printf("OTA BEGIN %d\n", (int)err);
  if (err != ESP_OK) return;
  size_t off = 0;
  while (off < ota_slot1_bin_len) {
    size_t chunk = ota_slot1_bin_len - off > 4096 ? 4096 : ota_slot1_bin_len - off;
    err = esp_ota_write(h, ota_slot1_bin + off, chunk);
    if (err != ESP_OK) {
      Serial.printf("OTA WRITE FAIL %d @%u\n", (int)err, (unsigned)off);
      return;
    }
    off += chunk;
  }
  Serial.printf("OTA WROTE %u\n", (unsigned)off);
  err = esp_ota_end(h);
  Serial.printf("OTA END %d\n", (int)err);
  if (err != ESP_OK) return;
  err = esp_ota_set_boot_partition(target);
  Serial.printf("OTA SETBOOT %d\n", (int)err);
  if (err != ESP_OK) return;
  Serial.println("OTA UPDATE DONE");
  Serial.flush();
  delay(200);
  esp_restart();
}

void loop() {
  delay(1000);
}
