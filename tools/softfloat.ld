/* softfloat.ld — link the ROM-stub soft-float bodies at 0x40002600,
 * resolving 64-bit integer helper calls to the ROM stub's fixed slots.
 * Regenerated by tools/gen_softfloat.sh. */
OUTPUT_ARCH(xtensa)

__ashldi3 = 0x400021b4;
__ashrdi3 = 0x400021c0;
__lshrdi3 = 0x400023d0;
__udivdi3 = 0x40002544;
__umoddi3 = 0x40002574;

SECTIONS
{
  . = 0x40002600;
  .bodies : {
    *(.text.__adddf3)
    *(.text.__subdf3)
    *(.text.__muldf3)
    *(.text.__divdf3)
    *(.text.__extendsfdf2)
    *(.text.__fixdfsi)
    *(.text.__floatsidf)
    *(.text.__floatunsidf)
    *(.text.__eqdf2)
    *(.text.__nedf2)
    *(.text.__gtdf2)
    *(.text.__ledf2)
    *(.text.__ltdf2)
    *(.text.__unorddf2)
    *(.text.__bswapsi2)
    *(.text.addsub)
    *(.text.cmp)
    *(.text.unpack)
    *(.text.pack)
  }
  /DISCARD/ : { *(*) }
}
